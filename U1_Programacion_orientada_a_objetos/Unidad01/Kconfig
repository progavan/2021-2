## U1_Programacion_orientada_a_objetos/Unidad01/Kconfig
```kconfig
config HELLO_WORLD
    bool "Ejemplo 'Hola Mundo' en C++"
    default y
    help
      Se configura el proyecto de tal mamnera que se incluye la funci\'on main
      de un programa "Hola Mundo" de lenguaje C++.

config CLASES_SIN_SECCIONES_PRIVADAS
    bool "ClaseSinSeccionesPrivadas.cpp utiliza la clase struct msg."
    default n
    help
      Se selecciona el programa que utiliza la clase struct msg, declarada en struct_msg.h

config SOBRECARGA_VERS_A
    bool "Versi\'on A de la sobrecarga del operador + para struct msg"
    depends on CLASES_SIN_SECCIONES_PRIVADAS
    help
      Se selecciona la vers\'on A de la sobrecarga del operador + para struct msg.

config SOBRECARGA_VERS_B
    bool "Versi\'on B de la sobrecarga del operador + para struct msg"
    depends on CLASES_SIN_SECCIONES_PRIVADAS
    help
      Se selecciona la vers\'on B de la sobrecarga del operador + para struct msg.

config SOBRECARGA_VERS_C
    bool "Versi\'on C de la sobrecarga del operador + para struct msg"
    depends on CLASES_SIN_SECCIONES_PRIVADAS
    help
      Se selecciona la vers\'on C de la sobrecarga del operador + para struct msg. En esta
      versi\'on de
      struct msg *operator+(struct_msg rhs),
      y de
      bool is_element(std::string),
      se utiliza el m\'etodo
      std::vector<std::string> tokenizing_w_r_t(char c),
      el cual proporciona un ejemplo de abstracci\'on de operaciones.

config USING_CALENDARIO_FOR_PLANNING
    bool "USING_CALENDARIO_FOR_PLANNING Esta opci\\'on por el momento (2022.03.04) rompe el proyecto Unidad01.cbp"
    default n
    help
      Esta opci\'on rompe el proyecto Unidad01.cbp (2022.03.04) debido a que por el momento
      no he incluido Dia.h,Dia.cpp, y no he incluido este archivo porque tambi\'en se tendr\ia
      que incluir otro archivo en el que est\'en definidos algunos archivos en donde se definan
      algunos arreglos de cadenas (que en el proyecto ProyYEst_2022_2_ICE.cbp si est\'an
      definidos en otro archivo fuente: PyE_data.cpp).

config DISPOSAL_RECORDS
    bool "DISPOSAL_RECORDS"
    default n
    help
      Calcula intervalo de las 5 fechas m\'as recientes.

config DIAS_TRANSCURRIDOS
   bool "DIAS_TRANSCURRIDOS DiasTranscurridos.cpp, Usa las clases Fecha y Calendario"
   default n
   help
     Se ejemplifica el uso de la clase sin secciones privadas Fecha,
     y de la clase Calendario.

config DIAS_TRANSCURRIDOS_1
   bool "DIAS_TRANSCURRIDOS_1 DiasTranscurridos_1.cpp, Usa las clases Fecha y Calendario"
   default n
   help
     Se ejemplifica el uso de la clase sin secciones privadas Fecha,
     y de la clase Calendario.
```

## U2_GUI/CodeblocksWorkspaceEleccionDCargaAcademica/01_IsGroupCompatibleWithThisHorario/Kconfig
```kconfig
config HORARIO_00
    bool "HORARIO_00 Grupos '1MV3 INTROPROG', '2MV9 PROGA', '3MM21 SOTR'"
    default n
    help
      (2022_2)

config HORARIO_01
    bool "HORARIO_01  Grupos '1MM1 INTROPROG', '2MV9 PROGA', '3MM21 SOTR'"
    default n
    help
      Se selecciona el programa del ejemplo 1 (diapositiva 8)

config HORARIO_02
    bool "HORARIO_02 Grupos '1MM2 INTROPROG', '2MV9 PROGA', '3MM21 SOTR'"
    default n
    help
      Se selecciona el programa del ejemplo 2 (diapositiva 11)

config HORARIO_03
    bool "HORARIO_03 Grupos '1TV1 PROGEST', '2MV9 PROGA', '3MM21 SOTR'"
    default n
    help
      Se selecciona el programa del ejemplo 3. El programa incluye limits.h,
      con lo que tiene acceso a las macros ULONG_MAX INT_MIN INT_MAX UINT_MAX LONG_MAX.
```
